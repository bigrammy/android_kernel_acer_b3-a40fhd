/*************************
 * Customized Battery Setting dtsi file
*************************/
&bat_comm {
	/* cust_charging.h */
	/* stop charging while in talking mode */
	stop_charging_in_takling = <1>;
	talking_recharge_voltage = <3800>;
	talking_sync_time = <60>;

	/* Battery Temperature Protection */
	mtk_temperature_recharge_support = <1>;
	max_charge_temperature = <50>;
	max_charge_temperature_minus_x_degree = <47>;
	min_charge_temperature = <0>;
	min_charge_temperature_plus_x_degree = <6>;
	err_charge_temperature = <0xff>;

	/* Linear Charging Threshold */
	v_pre2cc_thres = <3400>;	/* unit: mV */
	v_cc2topoff_thres = <4050>;
	recharging_voltage = <4110>;
	charging_full_current = <100>;	/* unit: mA */

	/* Charging Current Setting */
	config_usb_if = <0>;
	usb_charger_current_suspend = <0>;	/* Unit: 0.01 mA */
	usb_charger_current_unconfigured = <7000>;	/* Unit: 0.01 mA */
	usb_charger_current_configured = <50000>;	/* Unit: 0.01 mA */
	usb_charger_current = <50000>;	/* Unit: 0.01 mA */
	ac_charger_input_current = <200000 >; /* Unit: 0.01 mA @chenlijun 20170224 200000 */
	ac_charger_current = <200000>;	/* Unit: 0.01 mA */
	non_std_ac_charger_current = <50000>;	/* Unit: 0.01 mA */
	charging_host_charger_current = <65000>;	/* Unit: 0.01 mA */
	apple_0_5a_charger_current = <50000>;	/* Unit: 0.01 mA */
	apple_1_0a_charger_current = <65000>;	/* Unit: 0.01 mA */
	apple_2_1a_charger_current = <80000>;	/* Unit: 0.01 mA */

	/* charger error check */
	bat_low_temp_protect_enable = <0>;
	v_charger_enable = <0>;	/* 1:on , 0:off */
	v_charger_max = <6500>;	/* unit: mV */
	v_charger_min = <4400>;

	/*  Tracking TIME */
	onehundred_percent_tracking_time = <10>;	/* Unit: second */
	npercent_tracking_time = <20>;	/* Unit: second */
	sync_to_real_tracking_time = <60>;	/* Unit: second */
	v_0percent_tracking = <3500>;	/* Unit: mV */

	/* High battery support */
	high_battery_voltage_support = <0>;
};

&bat_meter {
	/* cust_battery_meter.h */
	/* ADC resistor  */
	r_bat_sense = <4>;
	r_i_sense = <4>;
	r_charger_1 = <330>;
	r_charger_2 = <39>;
	temperature_t0 = <110>;
	temperature_t1 = <0>;
	temperature_t2 = <25>;
	temperature_t3 = <50>;
	temperature_t = <255>;	/* this should be fixed, never change the value */
	fg_meter_resistance = <0>;

	/* Qmax for 0mA */
	q_max_pos_50 = <6406>;
	q_max_pos_25 = <6471>;
	q_max_pos_0 = <6469>;
	q_max_neg_10 = <6310>;
	/* Qmax for 600mA, said high current */
	q_max_pos_50_h_current = <6361>;
	q_max_pos_25_h_current = <6431>;
	q_max_pos_0_h_current = <6434>;
	q_max_neg_10_h_current = <6109>;
	/* Discharge percentage, 1: D5, 0: D2 */
	oam_d5 = <1>;

	change_tracking_point = <1>;
	/* SW OCV tracking setting */
	cust_tracking_point = <14>;
	cust_r_sense = <200>;
	cust_hw_cc = <0>;
	aging_tuning_value = <100>;
	cust_r_fg_offset = <0>;
	ocv_board_compesate = <0>;
	r_fg_board_base = <1000>;
	r_fg_board_slope = <1000>;
	car_tune_value = <89>;

	/* HW Fuel gague  */
	current_detect_r_fg = <10>;	/* Unit: mA */
	minerroroffset = <1000>;
	fg_vbat_average_size = <18>;
	r_fg_value = <10>;	/* Unit: mOhm */

	cust_poweron_delta_capacity_tolrance = <80>;
	cust_poweron_low_capacity_tolrance = <2>;
	cust_poweron_max_vbat_tolrance = <70>;
	cust_poweron_delta_vbat_tolrance = <60>;
	cust_poweron_delta_hw_sw_ocv_capacity_tolrance = <10>;

	/* Fixed battery temperature */
	fixed_tbat_25 = <0>;
	/* Dynamic change wake up period of battery thread when suspend */
	vbat_normal_wakeup = <3600>;	/* Unit: mV */
	vbat_low_power_wakeup = <3500>;	/* Unit: mV */
	normal_wakeup_period = <5400>;	/* Unit: second */
	low_power_wakeup_period = <300>;	/* Unit: second */
	close_poweroff_wakeup_period = <30>;	/* Unit: second */

	rbat_pull_up_r = <16900>;
	rbat_pull_up_volt = <1800>;

	batt_temperature_table_num = <17>;
	batt_temperature_table = <
        (-20) 70654
        (-15) 55337
        (-10) 43662
        (-5)  34696
         0 27760
         5 22358
        10 18121
        15 14778
        20 12122
        25 10000
        30 8295 
        35 6916 
        40 5796 
        45 4881
        50 4130
        55 3510 
        60 2997>;
			batt_temperature_table_tcl = <
        (-20) 72818
        (-15) 56587
        (-10) 44369
        (-5)  35085
         0 27965
         5 22459
        10 18167
        15 14795
        20 12126
        25 10000
        30 8295 
        35 6918 
        40 5801 
        45 4888
        50 4139
        55 3520 
        60 3007>;

	battery_profile_t0_num = <94>;
	battery_profile_t0 = <
0   4169
1   4152
2   4136
3   4115
4   4094
5   4082
6   4071
7   4056
9   4039
10  4022
11  4008
12  3997
13  3987
14  3979
15  3973
16  3967
17  3961
18  3957
19  3953
20  3950
21  3944
22  3939
24  3933
25  3927
26  3921
27  3914
28  3906
29  3899
30  3891
31  3885
32  3876
33  3870
34  3863
35  3857
36  3850
37  3845
38  3841
40  3835
41  3831
42  3827
43  3823
44  3819
45  3816
46  3813
47  3809
48  3806
49  3803
50  3801
51  3798
52  3795
53  3793
54  3790
56  3788
57  3787
58  3785
59  3782
60  3781
61  3780
62  3779
63  3778
64  3777
65  3775
67  3773
69  3770
71  3767
72  3765
73  3763
74  3761
75  3758
76  3753
78  3749
79  3746
80  3743
81  3738
82  3734
83  3731
84  3725
85  3720
87  3715
88  3710
89  3707
90  3704
91  3702
92  3697
93  3694
94  3687
95  3676
96  3657
97  3628
98  3589
99  3539
100 3472
100 3374
100 3154

>;
battery_profile_t0_tcl = <
0   4172
1   4160
2   4150
3   4140
4   4128
5   4118
6   4109
7   4098
8   4090
9   4080
11  4072
12  4066
13  4055
14  4046
15  4035
16  4027
17  4016
18  4006
19  3997
20  3989
21  3980
22  3974
23  3964
24  3958
25  3951
26  3942
27  3935
28  3927
29  3921
31  3912
32  3904
33  3895
34  3890
35  3881
36  3876
37  3869
38  3861
39  3857
40  3849
42  3840
43  3833
44  3829
45  3826
46  3821
47  3817
48  3813
49  3809
51  3806
52  3803
53  3800
54  3796
55  3794
56  3790
57  3788
58  3784
59  3782
60  3780
61  3779
62  3775
63  3773
64  3771
65  3770
66  3768
67  3766
68  3763
71  3761
72  3757
73  3755
74  3753
75  3750
76  3747
77  3744
78  3737
79  3738
80  3735
81  3731
82  3725
83  3719
84  3716
85  3710
86  3705
87  3700
88  3696
90  3693
91  3690
92  3686
93  3685
94  3681
95  3674
96  3663
97  3644
98  3609
99  3563
100 3497




>;

	battery_profile_t1_num = <94>;
	battery_profile_t1 = <
0    4169
1    4152
2    4140
3    4129
4    4119
5    4110
6    4102
7    4097
8    4092
10   4076
12   4050
13   4035
15   4012
17   3995
18   3989
19   3983
20   3979
22   3970
24   3961
25   3956
26   3951
27   3946
28   3940
29   3934
30   3928
31   3923
32   3916
33   3910
34   3903
35   3895
36   3887
37   3879
38   3872
39   3865
40   3858
41   3852
42   3847
43   3843
44   3838
45   3834
46   3831
47   3827
48   3823
49   3821
50   3817
51   3814
52   3812
53   3809
54   3807
55   3805
57   3800
58   3798
59   3797
60   3795
62   3792
64   3790
65   3789
66   3788
67   3788
68   3786
69   3785
70   3784
71   3783
72   3781
73   3779
75   3774
76   3772
77   3768
78   3766
79   3763
80   3760
81   3757
82   3753
83   3749
84   3744
85   3740
86   3736
87   3731
88   3725
89   3718
90   3712
91   3709
92   3707
93   3705
94   3703
95   3699
96   3693
97   3674
98   3639
99   3594
100  3536
100  3459
100  3344
100  3146

>;
		battery_profile_t1_tcl = <
0   4176
1   4162
2   4151
3   4139
4   4127
5   4117
6   4107
7   4098
8   4088
9   4079
10  4070
11  4062
13  4055
14  4044
15  4034
16  4027
17  4017
18  4008
19  4000
20  3992
21  3985
22  3977
23  3970
24  3964
25  3958
26  3952
27  3945
28  3939
29  3932
30  3926
31  3920
32  3913
33  3907
34  3900
36  3894
37  3887
38  3880
39  3873
40  3864
41  3857
42  3849
43  3843
44  3837
45  3831
46  3827
47  3821
48  3815
49  3811
50  3808
51  3804
52  3800
53  3797
54  3794
55  3791
56  3789
57  3787
59  3784
60  3781
61  3780
62  3779
63  3777
64  3774
65  3773
66  3773
67  3771
68  3770
71  3768
72  3766
73  3764
74  3762
76  3757
77  3755
78  3752
79  3749
80  3746
81  3741
83  3737
84  3731
85  3725
86  3718
87  3713
88  3705
89  3696
90  3689
91  3686
92  3684
93  3682
94  3678
95  3674
96  3666
97  3650
98  3609
99  3554
100 3479



>;

	battery_profile_t2_num = <94>;
	battery_profile_t2 = <
0     4186
1     4169
2     4159
4     4140
6     4121
8     4104
9     4095
10    4087
11    4073
13    4060
14    4050
15    4038
16    4027
17    4017
18    4008
19    4001
20    3994
21    3988
24    3972
25    3966
27    3955
28    3949
29    3943
30    3938
31    3932
32    3921
33    3915
34    3909
35    3903
36    3897
38    3883
39    3874
40    3865
41    3857
42    3850
43    3844
44    3839
45    3834
46    3830
47    3825
48    3822
49    3818
50    3815
51    3811
52    3809
53    3803
54    3800
55    3798
56    3795
57    3793
58    3791
59    3789
60    3787
61    3785
62    3783
63    3782
64    3780
65    3779
66    3777
67    3776
68    3775
69    3774
70    3772
71    3770
72    3766
73    3760
74    3757
75    3754
76    3750
77    3747
79    3742
80    3739
81    3736
82    3733
83    3729
84    3725
85    3720
86    3716
87    3712
88    3707
89    3701
90    3693
91    3690
93    3687
94    3682
95    3678
96    3666
97    3637
98    3599
99    3550
100   3486
100   3400
100   3258
100   3153

>;
	battery_profile_t2_tcl = <
0   4185
1   4175
2   4164
3   4154
4   4144
5   4135
6   4127
7   4118
8   4108
9   4099
10  4092
11  4083
12  4074
13  4067
14  4058
15  4052
16  4042
17  4034
18  4027
19  4020
20  4012
21  4006
22  3998
23  3992
24  3978
25  3972
26  3966
27  3960
28  3954
29  3948
30  3942
31  3937
32  3931
33  3926
34  3921
35  3915
36  3910
37  3904
38  3899
39  3892
40  3884
41  3876
42  3866
43  3857
44  3850
45  3842
46  3836
47  3832
48  3828
50  3821
51  3816
53  3811
54  3808
55  3805
56  3802
57  3800
58  3797
59  3794
60  3792
62  3789
63  3786
65  3783
66  3780
68  3778
69  3775
71  3772
72  3768
73  3765
74  3762
75  3759
76  3755
77  3752
78  3748
79  3744
80  3740
81  3737
82  3732
83  3726
84  3720
85  3713
86  3709
87  3703
88  3694
89  3686
90  3683
91  3680
93  3678
94  3676
95  3674
96  3667
97  3649
98  3614
99  3567
100 3427

>;

	battery_profile_t3_num = <94>;
	battery_profile_t3 = <
0   4179
1   4165
2   4151
3   4142
4   4133
5   4123
6   4112
7   4103
8   4094
9   4085
10  4067
11  4058
13  4041
14  4033
15  4026
16  4016
17  4008
19  3995
20  3985
21  3978
23  3964
25  3950
26  3943
28  3931
29  3923
31  3911
32  3900
33  3894
34  3889
35  3881
36  3877
37  3871
38  3864
39  3860
40  3852
41  3841
42  3833
43  3824
44  3816
45  3810
46  3805
47  3801
48  3798
49  3793
50  3787
51  3782
52  3779
53  3776
54  3772
55  3770
56  3768
57  3765
58  3764
59  3761
60  3759
61  3757
62  3754
64  3751
65  3748
67  3745
68  3743
69  3740
70  3737
71  3733
72  3728
73  3722
74  3719
75  3712
76  3709
77  3706
78  3703
79  3700
80  3697
81  3695
82  3692
83  3689
84  3686
85  3680
87  3672
88  3667
89  3658
90  3650
91  3646
93  3643
95  3640
96  3633
97  3621
98  3590
99  3551
100 3503
100 3441
100 3358
100 3227
100 3178
>;
      battery_profile_t3_tcl = <
0   4171
1   4160
2   4150
3   4140
4   4131
5   4120
6   4111
7   4101
8   4093
9   4085
10  4076
11  4068
12  4059
13  4050
14  4042
15  4035
16  4027
17  4019
18  4011
19  4004
20  3996
21  3988
22  3981
23  3975
24  3968
25  3961
26  3953
27  3948
28  3942
29  3936
30  3930
31  3923
32  3917
33  3912
34  3907
35  3901
36  3895
37  3891
38  3886
39  3879
40  3874
41  3868
42  3861
43  3851
44  3842
45  3833
46  3825
47  3819
49  3812
50  3808
51  3804
52  3800
53  3797
54  3793
55  3790
56  3787
57  3784
58  3781
59  3779
60  3776
62  3772
63  3770
64  3767
65  3765
66  3763
67  3761
68  3759
69  3757
70  3754
71  3752
72  3749
73  3742
74  3735
76  3729
77  3725
78  3722
79  3714
81  3708
83  3699
84  3693
85  3687
86  3680
87  3676
88  3669
89  3661
90  3656
92  3653
94  3650
95  3645
96  3640
97  3620
98  3584
99  3536
100 3479

>;

	r_profile_t0_num = <94>;
	r_profile_t0 = <
176     4169
176     4152
181     4136
189     4115
205     4094
219     4082
224     4071
228     4056
230     4039
231     4022
232     4008
234     3997
235     3987
237     3979
237     3973
240     3967
239     3961
241     3957
243     3953
247     3950
228     3944
247     3939
246     3933
248     3927
247     3921
247     3914
245     3906
246     3899
242     3891
240     3885
238     3876
237     3870
237     3863
236     3857
198     3850
231     3845
234     3841
233     3835
233     3831
236     3827
237     3823
236     3819
237     3816
238     3813
238     3809
239     3806
240     3803
240     3801
241     3798
241     3795
242     3793
243     3790
244     3788
246     3787
247     3785
246     3782
247     3781
247     3780
248     3779
249     3778
249     3777
251     3775
253     3773
252     3770
251     3767
254     3765
255     3763
254     3761
255     3758
255     3753
257     3749
258     3746
259     3743
260     3738
259     3734
262     3731
263     3725
263     3720
266     3715
267     3710
273     3707
278     3704
288     3702
295     3697
309     3694
322     3687
340     3676
360     3657
386     3628
427     3589
488     3539
584     3472
595     3374
562     3154
>;
	r_profile_t0_tcl = <
 169	    4172
169	    4160
173	    4150
176	    4140
176	    4128
178	    4118
184	    4109
183	    4098
187	    4090
188	    4080
191	    4072
194	    4066
193	    4055
194	    4046
192	    4035
197	    4027
198	    4016
197	    4006
198	    3997
201	    3989
198	    3980
201	    3974
198	    3964
199	    3958
199	    3951
196	    3942
195	    3935
196	    3927
195	    3921
190	    3912
189	    3904
184	    3895
189	    3890
184	    3881
183	    3876
181	    3869
176	    3861
181	    3857
176		  3849
176	    3840
176	    3833
174	    3829
178	    3826
178	    3821
180	    3817
177	    3813
178	    3809
181	    3806
180	    3803
182	    3800
182	    3796
185	    3794
182	    3790
184	    3788
184	    3784
185	    3782
185	    3780
189	    3779
186	    3775
186	    3773
186	    3771
188	    3770
187	    3768
188	    3766
190	    3763
191	    3761
188	    3757
189	    3755
189	    3753
191	    3750
190	    3747
189	    3744
188	    3737
172	    3738
192	    3735
196	    3731
194	    3725
192	    3719
194	    3716
188	    3710
188	    3705
187	    3700
189	    3696
189	    3693
193	    3690
200	    3686
202	    3685
225	    3681
240	    3674
256	    3663
270	    3644
285	    3609
330	    3563
419	    3497


>;

	r_profile_t1_num = <94>;
	r_profile_t1 = <
122     4169
122     4152
124     4140
124     4129
126     4119
127     4110
128     4102
130     4097
131     4092
131     4076
132     4050
133     4035
133     4012
136     3995
136     3989
137     3983
139     3979
138     3970
143     3961
144     3956
144     3951
146     3946
146     3940
146     3934
147     3928
147     3923
145     3916
144     3910
144     3903
142     3895
139     3887
137     3879
135     3872
134     3865
132     3858
131     3852
129     3847
127     3843
127     3838
126     3834
129     3831
129     3827
128     3823
129     3821
129     3817
130     3814
131     3812
131     3809
128     3807
129     3805
132     3800
133     3798
133     3797
134     3795
134     3792
135     3790
134     3789
134     3788
134     3788
136     3786
136     3785
136     3784
136     3783
136     3781
137     3779
136     3774
134     3772
132     3768
133     3766
136     3763
136     3760
136     3757
136     3753
137     3749
137     3744
138     3740
138     3736
139     3731
138     3725
135     3718
137     3712
139     3709
141     3707
144     3705
150     3703
156     3699
164     3693
165     3674
167     3639
174     3594
193     3536
236     3459
335     3344
394     3146
>;
   r_profile_t1_tcl = <
 114	        4176	
114	        4162	
115	        4151	
114	        4139	
115	        4127	
119	        4117	
115	        4107	
119	        4098	
119	        4088	
121	        4079	
122	        4070	
124	        4062	
125	        4055	
124	        4044	
124	        4034	
130	        4027	
128	        4017	
132	        4008	
134	        4000	
132	        3992	
136	        3985	
135	        3977	
136	        3970	
138	        3964	
139	        3958	
141	        3952	
143	        3945	
142	        3939	
142	        3932	
144	        3926	
144	        3920	
143	        3913	
142	        3907	
141	        3900	
142	        3894	
140	        3887	
137	        3880	
136	        3873	
132	        3864	
129	        3857	
125	        3849	
124	        3843	
122	        3837	
121	        3831	
122	        3827	
120	        3821	
116	        3815	
116	        3811	
119	        3808	
118	        3804	
116	        3800	
118	        3797	
117	        3794	
117	        3791	
120	        3789	
119	        3787	
117	        3784	
117	        3781	
122	        3780	
122	        3779	
122	        3777	
120	        3774	
122	        3773	
125	        3773	
124	        3771	
124			    3770	
126	        3768	
124	        3766	
126	        3764	
124		      3762	
125	        3757	
126	        3755	
124	        3752	
126	        3749	
126	        3746	
125	        3741	
126	        3737	
124	        3731	
124	        3725	
125	        3718	
127	        3713	
125	        3705	
123	        3696	
120	        3689	
122	        3686	
125	        3684	
127	        3682	
133	        3678	
141	        3674	
154	        3666	
159	        3650	
154	        3609	
165	        3554	
188	        3479	

>;

	r_profile_t2_num = <94>;
	r_profile_t2 = <
84  4186
84  4169
85  4159
86  4140
86  4121
87  4104
87  4095
88  4087
89  4073
89  4060
89  4050
88  4038
88  4027
89  4017
89  4008
89  4001
89  3994
89  3988
91  3972
91  3966
92  3955
92  3949
92  3943
93  3938
93  3932
94  3921
96  3915
96  3909
97  3903
98  3897
95  3883
93  3874
91  3865
89  3857
87  3850
88  3844
87  3839
87  3834
86  3830
86  3825
87  3822
87  3818
86  3815
86  3811
87  3809
87  3803
87  3800
87  3798
87  3795
87  3793
87  3791
87  3789
87  3787
88  3785
88  3783
89  3782
89  3780
90  3779
89  3777
90  3776
91  3775
91  3774
90  3772
89  3770
88  3766
87  3760
87  3757
87  3754
87  3750
86  3747
88  3742
87  3739
87  3736
88  3733
87  3729
88  3725
88  3720
88  3716
89  3712
89  3707
89  3701
88  3693
88  3690
90  3687
92  3682
93  3678
92  3666
92  3637
93  3599
96  3550
99  3486
108 3400
132 3258
237 3153
>;
r_profile_t2_tcl = <
 87	  4185
 87	  4175
 87	  4164
 88	  4154
 86	  4144
 87	  4135
 90	  4127
 90	  4118
 88	  4108
 86	  4099
 91	  4092
 89	  4083
 87	  4074
 91	  4067
 90	  4058
 93	  4052
 90	  4042
 90	  4034
 91	  4027
 92	  4020
 92	  4012
 94	  4006
 94	  3998
 94		3992
 95	  3978
 94	  3972
 97	  3966
 97	  3960
 97	  3954
 100	  3948
 101	  3942
 103	  3937
 103	  3931
 104	  3926
 106	  3921
 105	  3915
 108	  3910
 108	  3904
 110	  3899
 110	  3892
 107	  3884
 106	  3876
 98	  3866
 95	  3857
 94	  3850
 90	  3842
 88	  3836
 90	  3832
 92		3828
 91	  3821
 89		3816
 90	  3811
 91	  3808
 90	  3805
 90	  3802
 91	  3800
 90	  3797
 91	  3794
 91		3792
 96	  3789
 95		3786
 95	  3783
 95		3780
 94	  3778
 94		3775
 95		3772
 94	  3768
 94	  3765
 92	  3762
 91	  3759
 91	  3755
 93	  3752
 93	  3748
 91	  3744
 91	  3740
 92	  3737
 91	  3732
 90	  3726
 92	  3720
 90	  3713
 93	  3709
 91	  3703
 91	  3694
 89	  3686
 88	  3683
 89		3680
 94	  3678
 97	  3676
 101	  3674
 101	  3667
 98	  3649
 98	  3614
 101	  3567
 106	  3427


>;

	r_profile_t3_num = <94>;
	r_profile_t3 = <
81   4179
81   4165
76   4151
79   4142
81   4133
81   4123
79   4112
81   4103
79   4094
79   4085
81   4067
79   4058
79   4041
81   4033
81   4026
79   4016
79   4008
84   3995
81   3985
79   3978
81   3964
81   3950
81   3943
84   3931
81   3923
81   3911
86   3900
86   3894
86   3889
84   3881
86   3877
86   3871
86   3864
88   3860
88   3852
84   3841
83   3833
81   3824
79   3816
79   3810
79   3805
81   3801
81   3798
81   3793
81   3787
79   3782
79   3779
79   3776
79   3772
76   3770
79   3768
81   3765
81   3764
81   3761
81   3759
84   3757
81   3754
84   3751
81   3748
81   3745
81   3743
83   3740
81   3737
81   3733
81   3728
81   3722
81   3719
79   3712
79   3709
79   3706
79   3703
79   3700
81   3697
81   3695
81   3692
81   3689
81   3686
79   3680
79   3672
79   3667
84   3658
81   3650
79   3646
79   3643
84   3640
86   3633
86   3621
84   3590
86   3551
86   3503
91   3441
98   3358
119  3227
141  3178
>;
	r_profile_t3_tcl = <
82	  4171
82	  4160
84	  4150
84	  4140
85	  4131
82	  4120
83	  4111
81	  4101
84	  4093
83	  4085
82	  4076
83	  4068
84	  4059
84	  4050
82	  4042
84	  4035
85	  4027
84	  4019
85	  4011
86	  4004
85	  3996
85	  3988
84	  3981
88	  3975
88	  3968
86	  3961
85	  3953
87	  3948
87	  3942
89	  3936
90	  3930
88	  3923
87	  3917
88	  3912
91	  3907
90	  3901
92	  3895
92	  3891
95	  3886
94	  3879
95	  3874
95	  3868
97	  3861
93	  3851
91	  3842
87	  3833
85	  3825
84		3819
86	  3812
86	  3808
84	  3804
86	  3800
85	  3797
84	  3793
84	  3790
84	  3787
85	  3784
86	  3781
85	  3779
87	  3776
87	  3772
90	  3770
88	  3767
87	  3765
88	  3763
88	  3761
89	  3759
89	  3757
88	  3754
89	  3752
89	  3749
85	  3742
84		3735
84	  3729
84	  3725
84		3722
83		3714
86	  3708
84	  3699
84	  3693
85	  3687
82	  3680
86	  3676
88	  3669
84	  3661
83	  3656
88		3653
92	  3650
92	  3645
96	  3640
91	  3620
91	  3584
90	  3536
94	  3479

>;
};
